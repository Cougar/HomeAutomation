/*********************************************************************
 *
 *                  Main application
 *
 *********************************************************************
 * FileName:        $HeadURL$
 * Last changed:	$LastChangedDate$
 * By:				$LastChangedBy$
 * Revision:		$Revision$
 ********************************************************************/


#include <compiler.h>
#include <stackTasks.h>
#include <Tick.h>
#include <funcdefs.h>
#include <CAN.h>
#include "..\canBoot\Include\boot.h"

#ifdef USE_GLCD
	#include "glcd.h"
#endif

#ifdef USE_GLCD
	const rom BYTE pic[]={
0x00,0x00,0x00,0x00,0x00,0x00,0x00,0x00,
0x00,0x00,0x00,0x00,0x00,0x00,0x00,0x00,
0x00,0x00,0x00,0x60,0x90,0x90,0x10,0x30,
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0x00,0x00,0x00,0x00,0x00,0x00,0x00,0x00
};

const rom BYTE pic2[] = {
0x00,0x00,0x00,0x00,0x00,0x00,0x00,0x00,
0x00,0x00,0x00,0x00,0x00,0x00,0x00,0x00,
0x00,0x00,0x00,0x00,0x00,0x00,0x00,0x00,
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0x00,0x00,0x00,0x00,0x00,0x00,0x00,0x00
};

const rom BYTE pic3[] = {
'\xff','\xff','\xff','\xff','\xff','\xff','\xff','\xff',
'\xff','\xff','\xff','\xff','\xff','\xff','\xff','\xff',
'\xff','\xff','\xff','\xff','\xff','\xff','\xff','\xff',
'\xf9','\xff','\xff','\xff','\xff','\xff','\xff','\xff',
'\xe1','\xff','\xff','\xff','\xff','\xff','\xff','\xff',
'\xed','\xff','\xff','\xff','\xff','\xff','\xff','\xff',
'\xdd','\xff','\xff','\xff','\xff','\xff','\xff','\xff',
'\x9d','\xff','\xff','\xff','\xff','\xff','\xff','\xff',
'\xb9','\xff','\xff','\xff','\xff','\xff','\xff','\xff',
'\xbb','\xff','\xff','\x07','\xfc','\xff','\xff','\xff',
'\x7b','\xfe','\xff','\xfb','\xfb','\xff','\xff','\xff',
'\xfb','\xfe','\xff','\xf9','\xf3','\xff','\xff','\xff',
'\xf3','\xfc','\xff','\xfd','\xe7','\xff','\xff','\xff',
'\x07','\xfc','\xff','\xfc','\xef','\xff','\xff','\xff',
'\xf7','\xfd','\x7f','\xfe','\xdf','\xff','\xff','\xff',
'\xf7','\xfd','\x7f','\xff','\xdf','\xff','\xff','\xff',
'\xf7','\xfd','\x7f','\xff','\xbf','\xff','\xff','\xff',
'\xf7','\xfd','\x7f','\x1f','\x70','\xff','\xff','\xff',
'\xf7','\x3d','\x00','\xe7','\x67','\xff','\xff','\xff',
'\xf7','\xdd','\x7f','\xfb','\x6f','\xff','\xff','\xff',
'\xf7','\xe5','\x7f','\xfb','\xef','\xfe','\xff','\xff',
'\xf7','\xf9','\x7f','\xfb','\xef','\xfe','\xff','\xff',
'\xf7','\xfa','\x7f','\xfb','\xef','\xfd','\xff','\xff',
'\xf7','\xfc','\x7f','\xfb','\xef','\xfd','\xff','\xff',
'\xf7','\xfc','\x7f','\xfb','\xef','\xfb','\xff','\xff',
'\xf7','\xfc','\x7f','\xfb','\xef','\xfb','\xff','\xff',
'\xf7','\xfe','\x7f','\xf9','\xef','\xfb','\xff','\xff',
'\xf7','\xfe','\x7f','\xf9','\xef','\x87','\xff','\xff',
'\xf7','\xfe','\x7f','\xf9','\xef','\xb7','\xff','\xff',
'\xf7','\xfe','\x7f','\xf9','\xf7','\xb7','\xff','\xff',
'\xf7','\xfc','\x7f','\xf3','\xf7','\xb7','\xff','\xff',
'\xf7','\xfc','\x7f','\xe7','\xfb','\xb7','\xff','\xff',
'\xf7','\xfa','\x7f','\x1f','\xfc','\xb7','\xff','\xff',
'\xf7','\x7a','\x78','\xff','\xff','\xb7','\xff','\xff',
'\xf7','\x36','\x70','\xff','\xff','\x37','\xff','\xff',
'\xf7','\x36','\x70','\xff','\xff','\x77','\xff','\xff',
'\xf7','\x4e','\x70','\xff','\xff','\x77','\xff','\xff',
'\xf7','\x1e','\x00','\xff','\xff','\x77','\xff','\xff',
'\xf7','\xfe','\x7f','\xff','\xff','\x77','\xff','\xff',
'\xf7','\xfe','\x7f','\xff','\xff','\x77','\xff','\xff',
'\xf7','\xfe','\x7f','\xff','\xff','\x77','\xff','\xff',
'\xf7','\xfe','\x7f','\xff','\xff','\x77','\xff','\xff',
'\xf7','\xfe','\x7f','\xff','\xff','\x77','\xff','\xff',
'\xf7','\xfe','\x7f','\xff','\xff','\x77','\xff','\xff',
'\xf7','\xfe','\x7f','\xff','\xff','\x77','\xfe','\xff',
'\xf7','\xfe','\x7f','\xff','\xff','\x77','\xf0','\xff',
'\xf7','\xfe','\x7f','\xff','\xff','\x77','\xe7','\xff',
'\xf7','\xfe','\x7f','\xff','\xff','\x77','\xef','\xff',
'\xf7','\xfe','\x7f','\xff','\xff','\x77','\xcf','\xff',
'\xf7','\xfe','\x7f','\xff','\xff','\x77','\x3f','\xff',
'\xf7','\xfe','\x7f','\xff','\xff','\x77','\x7f','\xf8',
'\xf7','\xfe','\x7f','\xff','\xff','\x77','\xff','\xe7',
'\xf7','\xfe','\x7f','\xff','\xff','\x77','\xff','\xef',
'\xf7','\xfe','\x7f','\xff','\xff','\x77','\xff','\xef',
'\xf7','\xfe','\x7f','\xff','\xff','\x77','\xff','\xe0',
'\xf7','\xfe','\x7f','\xff','\xff','\x77','\xff','\xfe',
'\xf7','\xfe','\x7f','\xff','\xff','\x77','\xc0','\xfe',
'\xf7','\xfe','\x7f','\xff','\xff','\x7b','\xdf','\xc0',
'\xf7','\xfe','\x7f','\xff','\xff','\x7b','\xdf','\x9f',
'\xf7','\xfe','\x7f','\xff','\xff','\x7b','\xdf','\xbf',
'\xf7','\xfc','\x7f','\xff','\xff','\x7b','\xdf','\xbf',
'\xf7','\xfd','\x7f','\xff','\xff','\x7b','\xdf','\x81',
'\xf7','\xfd','\x7f','\xff','\xff','\x7b','\xdf','\xfd',
'\xf7','\xfd','\x7f','\xff','\xff','\x7b','\xdf','\xfd',
'\xf7','\xfd','\x7f','\x3f','\xf8','\x3d','\xdf','\xfd',
'\xf7','\x0d','\x00','\xcf','\xfb','\xbd','\xdf','\xfd',
'\xf7','\x22','\x60','\xe7','\xf7','\x9d','\xdf','\xfd',
'\xf7','\x38','\x70','\xf7','\xf7','\xdd','\xdf','\xfd',
'\xf7','\xfc','\x7f','\xf3','\xf7','\xcd','\xdf','\xfd',
'\xf7','\xfc','\x7f','\xfb','\xf7','\xe5','\xdf','\xfd',
'\xf7','\xfe','\x7f','\xfb','\xf7','\xf8','\xdf','\xfd',
'\xf7','\xfe','\x7f','\xfb','\xf7','\xfe','\xdf','\xfd',
'\xf7','\xfe','\x7f','\xfb','\xf7','\xfe','\xdf','\xfd',
'\xf7','\xfe','\x7f','\xfb','\xf7','\xfe','\xdf','\xfd',
'\xf7','\xfc','\x7f','\xfb','\xf7','\xfe','\xdf','\xfd',
'\xf7','\xfc','\x7f','\xf3','\xf7','\xfe','\xdf','\xfd',
'\xf7','\xf8','\x7f','\xf3','\xf7','\xfe','\xdf','\xfd',
'\xf3','\xf2','\x7f','\xf3','\xf7','\xfe','\xdf','\xfd',
'\x03','\xe6','\x7f','\xf3','\xf8','\xfe','\xdf','\xfd',
'\xfb','\xce','\x7f','\x03','\xfe','\xfe','\xdf','\xfd',
'\xfb','\x1e','\x7f','\xfb','\xff','\xfe','\xdf','\xfd',
'\xfb','\x7e','\x00','\xff','\xff','\xfe','\xdf','\xfd',
'\xfb','\xfe','\x7f','\xff','\xff','\xfe','\xdf','\xfd',
'\xf9','\xfe','\x7f','\xff','\x7f','\xfe','\xdf','\xfd',
'\x7d','\xfe','\x7f','\xff','\x7f','\xff','\xdf','\xfd',
'\x05','\xff','\x7f','\xff','\x7f','\xff','\xdf','\xfd',
'\xf9','\xff','\x3f','\xff','\x3f','\xff','\xdf','\xfd',
'\xff','\xff','\x7f','\xff','\xbf','\xff','\xdf','\xfd',
'\xff','\xff','\x7f','\xfe','\xdf','\xff','\xdf','\xfd',
'\xff','\xff','\xff','\xfe','\xcf','\xff','\xdf','\xfd',
'\xff','\xff','\xff','\x00','\xe0','\xff','\xdf','\xfd',
'\xff','\xff','\xff','\xff','\xff','\xff','\xdf','\xfd',
'\xff','\xff','\xff','\xff','\xff','\xff','\xdf','\xfd',
'\xff','\xff','\xff','\xff','\xff','\xff','\xdf','\xfd',
'\xff','\xff','\xff','\xff','\xff','\xff','\xdf','\xfd',
'\xff','\xff','\xff','\xff','\xff','\xff','\xdf','\xfd',
'\xff','\xff','\xff','\xff','\xff','\xff','\xdf','\xfd',
'\xff','\xff','\xff','\xff','\xff','\xff','\xdf','\xe1',
'\xff','\xff','\xff','\xff','\xff','\xff','\xdf','\xdf',
'\xff','\xff','\xff','\xff','\xff','\xff','\xdf','\xdf',
'\xff','\xff','\xff','\xff','\xff','\xff','\xdf','\xbf',
'\xff','\xff','\xff','\xff','\xff','\xff','\xdf','\x81',
'\xff','\xff','\xff','\xff','\xff','\xff','\xdf','\xfc',
'\xff','\xff','\xff','\xff','\xff','\xff','\xdf','\xfe',
'\xff','\xff','\xff','\xff','\xff','\xff','\xdf','\xfe',
'\xff','\xff','\xff','\xff','\xff','\xff','\xbf','\xe0',
'\xff','\xff','\xff','\xff','\xff','\xff','\xbf','\xdf',
'\xff','\xff','\xff','\xff','\xff','\xff','\xbf','\xdf',
'\xff','\xff','\xff','\xff','\xff','\xff','\x3f','\xdf',
'\xff','\xff','\xff','\xff','\xff','\xff','\x3f','\xc0',
'\xff','\xff','\xff','\xff','\xff','\xff','\xbf','\xff',
'\xff','\xff','\xff','\xff','\xff','\xff','\xbf','\xff',
'\xff','\xff','\xff','\xff','\xff','\xff','\xbf','\xff',
'\xff','\xff','\xff','\xff','\xff','\xff','\xbf','\xff',
'\xff','\xff','\xff','\xff','\xff','\xff','\xbf','\xff',
'\xff','\xff','\xff','\xff','\xff','\xff','\xbf','\xff',
'\xff','\xff','\xff','\xff','\xff','\xff','\x7f','\xff',
'\xff','\xff','\xff','\xff','\xff','\xff','\x7f','\xff',
'\xff','\xff','\xff','\xff','\xff','\xff','\x7f','\xff',
'\xff','\xff','\xff','\xff','\xff','\xff','\x7f','\xce',
'\xff','\xff','\xff','\xff','\xff','\xff','\xbf','\xc0',
'\xff','\xff','\xff','\xff','\xff','\xff','\xbf','\xfd',
'\xff','\xff','\xff','\xff','\xff','\xff','\xbf','\xfd',
'\xff','\xff','\xff','\xff','\xff','\xff','\xbf','\xfb',
'\xff','\xff','\xff','\xff','\xff','\xff','\xbf','\xf3',
'\xff','\xff','\xff','\xff','\xff','\xff','\xff','\xf7',
'\xff','\xff','\xff','\xff','\xff','\xff','\xff','\xff',
'\xff','\xff','\xff','\xff','\xff','\xff','\xff','\xff'
};




rom BYTE str[] = "Johboh är bäst! ;)";

#endif

static void mainInit(void);





void main()
{
	// Inits
	mainInit();
	canInit();


	#ifdef USE_GLCD
		GLCD_CS_IO = 0;
		glcdInit();
		GLCD_CS_IO = 1;
	#endif

	while(1)
	{
		TICK currentTick = tickGet();
		static TICK tick_led = 0;
		static TICK tick_pic = 0;

		static BYTE picCnt = 0;

		if ((currentTick-tick_led)>(1*TICK_1S))
		{
			LED0_IO=~LED0_IO;
			tick_led = currentTick;
		}

		#ifdef USE_GLCD
		if ((currentTick-tick_pic)>(5*TICK_1S))
		{
			CAN_PACKET outCp;	

			GLCD_CS_IO = 0;
			glcdSetStartLine(0x00);
			glcdClearScr();
			if (picCnt==0) glcdDisplayPic(0,0,pic);
			else if (picCnt==1) glcdDisplayPic(0,0,pic2);
			else if (picCnt==2) glcdPutrs(0,0,str);
			else if (picCnt==3) glcdDisplayPic(0,0,pic3);
			GLCD_CS_IO = 1;

			outCp.type 		= ptPGM;
			outCp.pgm.class = pcSENSOR;
			outCp.pgm.id 	= pstIR;
			outCp.length 	= 1;
			outCp.data[0]	= picCnt;
			while(!canSendMessage(outCp,PRIO_HIGH));


			if (++picCnt>3) picCnt=0;

			tick_pic = currentTick;
		}
		#endif

	}
}


#pragma interrupt high_isr
void high_isr(void)
{
	canISR();
}


#pragma interrupt low_isr
void low_isr(void)
{

}



/*
*	Function: mainInit
*
*	Input:	none
*	Output: none
*	Pre-conditions: none
*	Affects: Se code
*	Depends: none.
*/
void mainInit()
{
	LED0_TRIS=0;	

	// Enable Interrupts
    INTCONbits.GIEH = 1;
    INTCONbits.GIEL = 1;

	// Enable interrupt prirority
	RCONbits.IPEN=1;
	

}

/*
*	Function: canParse
*
*	Input:	Received can message
*	Output: none
*	Pre-conditions: canInit and received packet.
*	Affects: Sensors/actuators/etc. See code.
*	Depends: none.
*/
void canParse(CAN_PACKET cp)
{

}


// Below are mandantory when using bootloader
// define DEBUG_MODE to use without bootloader.

#ifndef DEBUG_MODE
extern void _startup (void); 
#pragma code _RESET_INTERRUPT_VECTOR = RM_RESET_VECTOR
void _reset (void)
{
    _asm goto _startup _endasm
}
#pragma code
#endif

#pragma code _HIGH_INTERRUPT_VECTOR = RM_HIGH_INTERRUPT_VECTOR
void _high_ISR (void)
{
	_asm GOTO high_isr _endasm
}
#pragma code

#pragma code _LOW_INTERRUPT_VECTOR = RM_LOW_INTERRUPT_VECTOR
void _low_ISR (void)
{
    _asm GOTO low_isr _endasm
}
#pragma code



